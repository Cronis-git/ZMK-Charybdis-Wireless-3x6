/*
 * Copyright (c) 2020 ZMK Contributors
 *
 * SPDX-License-Identifier: MIT
 */
 
#include "charybdis.dtsi"
#include "pmw3610.dtsi"
#include <zephyr/dt-bindings/input/input-event-codes.h>
#include <dt-bindings/zmk/input_transform.h>


&default_transform {
    col-offset = <6>;
};

&five_column_transform {
    col-offset = <5>;
};


