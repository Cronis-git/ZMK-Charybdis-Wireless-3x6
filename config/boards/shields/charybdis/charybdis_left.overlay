/*
 * Copyright (c) 2020 ZMK Contributors
 *
 * SPDX-License-Identifier: MIT
 */

#include "charybdis.dtsi"
#include "pmw3610.dtsi"


&spi0 {
    status = "disabled";
};

&trackball {
	status = "disabled";
};
